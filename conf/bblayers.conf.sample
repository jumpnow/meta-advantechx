## conf/bblayers.conf.sample
```bitbake
# POKY_BBLAYERS_CONF_VERSION is increased each time build/conf/bblayers.conf
# changes incompatibly
POKY_BBLAYERS_CONF_VERSION = "2"

BBPATH = "${TOPDIR}"
BBFILES ?= ""

BBLAYERS ?= " \
  ${HOME}/poky-scarthgap/meta \
  ${HOME}/poky-scarthgap/meta-poky \
  ${HOME}/poky-scarthgap/meta-openembedded/meta-oe \
  ${HOME}/poky-scarthgap/meta-openembedded/meta-multimedia \
  ${HOME}/poky-scarthgap/meta-openembedded/meta-networking \
  ${HOME}/poky-scarthgap/meta-openembedded/meta-python \
  ${HOME}/poky-scarthgap/meta-arm/meta-arm \
  ${HOME}/poky-scarthgap/meta-arm/meta-arm-bsp \
  ${HOME}/poky-scarthgap/meta-arm/meta-arm-toolchain \
  ${HOME}/poky-scarthgap/meta-freescale \
  ${HOME}/poky-scarthgap/meta-imx/meta-imx-bsp \
  ${HOME}/advantechx/meta-advantechx \
"
```

## conf/layer.conf
```bitbake
BBPATH .= ":${LAYERDIR}"

BBFILES += "${LAYERDIR}/recipes*/*/*.bb ${LAYERDIR}/recipes*/*/*.bbappend ${LAYERDIR}/images/*.bb"

BBFILE_COLLECTIONS += "meta-advantech-imx8"
BBFILE_PATTERN_meta-advantech-imx8 := "^${LAYERDIR}/"
BBFILE_PRIORITY_meta-advantech-imx8 = "16"

LAYERSERIES_COMPAT_meta-advantech-imx8 = "scarthgap"
```

## conf/local.conf.sample
```bitbake
# Local configuration for meta-advantechx images
# Only tested with the Advantech imx8ulp ROM2620 eval board

ACCEPT_FSL_EULA = "1"

DISTRO = "poky"

DISTRO_FEATURES = "ext2 opengl systemd usbhost ${DISTRO_FEATURES_LIBC}"

DISTRO_FEATURES_BACKFILL_CONSIDERED += "pulseaudio sysvinit"

DISTRO_FEATURES:remove = "ptest"

INIT_MANAGER = "systemd"

EXTRA_IMAGEDEPENDS += "\
    virtual/bootloader \
    u-boot-scr \
"

PACKAGE_CLASSES = "package_ipk"

SDKMACHINE = "x86_64"

PREFERRED_VERSION_opencv:mx8-nxp-bsp = "4.9.%"

MACHINE = "imx8ulprom2620a1"

KERNEL_DEVICETREE_BASENAME = "imx8ulp-rom2620-a1-lt9211"
#KERNEL_DEVICETREE_BASENAME = "imx8ulp-rom2620-a1-lt9211-800x480"

IMAGE_FSTYPES = "tar.gz wic.zst"
#IMAGE_FSTYPES = "tar.gz"

WKS_FILE = "adv-imx-uboot-bootpart.wks.in"

#DL_DIR = "/src/scarthgap"
#SSTATE_DIR = "/oe2/advantechx/sstate-cache"
#TMPDIR = "/oe2/advantechx/tmp"

EXTRA_IMAGE_FEATURES = "debug-tweaks"

PATCHRESOLVE = "noop"
RM_OLD_IMAGE = "1"
INHERIT += "rm_work create-spdx"
CONF_VERSION = "2"
```

## conf/machine/imx8ulprom2620a1.conf
```bitbake
#@TYPE: Machine
#@NAME: i.MX 8ULP EVK
#@SOC: i.MX8ULP
#@DESCRIPTION: Machine configuration for NXP i.MX 8ULP Evaluation Kit with LPDDR4
#@MAINTAINER: Jun Zhu <junzhu@nxp.com>

IMX_DEFAULT_BSP = "nxp"

IMAGE_BOOT_FILES:append = " boot.scr"

require conf/machine/include/adv-imx8ulp-evk.inc

IMX_SOC_REV_UPPER = "A2"
IMAGE_FSTYPES ?= "tar.gz wic.zst"

PREFERRED_PROVIDER_virtual/kernel ?= "linux-advantech"

MACHINE_ESSENTIAL_EXTRA_RDEPENDS = "kernel-devicetree kernel-modules"

# no display
#KERNEL_DEVICETREE_BASENAME ?= "imx8ulp-rom2620-a1"

# dev kit display at 1920x1080 resolution
KERNEL_DEVICETREE_BASENAME ?= "imx8ulp-rom2620-a1-lt9211"

# this default is the same as the -a1-lt9211 dts but with the display
# set to 800x480 resolution which is what we want
#KERNEL_DEVICETREE_BASENAME ?= "imx8ulp-rom2620-a1-lt9211-800x480"

IMX_DEFAULT_BOOTLOADER:imx-nxp-bsp = "u-boot-imx"
UBOOT_SUFFIX:pn-u-boot-imx:mx8-nxp-bsp = "bin"
UBOOT_SUFFIX:pn-u-boot-imx-mfgtool:mx8-nxp-bsp = "bin"
IMX_DEFAULT_UBOOTTOOLS = "u-boot-imx-tools"
PREFERRED_PROVIDER_u-boot-tools-native = "${IMX_DEFAULT_UBOOTTOOLS}-native"
PREFERRED_PROVIDER_nativesdk-u-boot-tools = "nativesdk-${IMX_DEFAULT_UBOOTTOOLS}"
PREFERRED_PROVIDER_u-boot-mkimage-native = "${IMX_DEFAULT_UBOOTTOOLS}-native"
PREFERRED_PROVIDER_nativesdk-u-boot-mkimage = "nativesdk-${IMX_DEFAULT_UBOOTTOOLS}"

QEMUVERSION = "8.2.7"
PREFERRED_VERSION_qemu = "${QEMUVERSION}"
PREFERRED_VERSION_qemu-native = "${QEMUVERSION}"
PREFERRED_VERSION_nativesdk-qemu = "${QEMUVERSION}"

UBOOT_CONFIG_BASENAME = "imx8ulp_rom2620a1"

MACHINE_FEATURES += "soc-reva2"
UPOWER_FIRMWARE_NAME = "upower_a1.bin"

SECO_FIRMWARE_NAME:mx8ulp-generic-bsp = "mx8ulpa2-ahab-container.img"

IMXBOOT_TARGETS_SD:imx8ulp-lpddr4-evk   = "flash_singleboot_m33 flash_singleboot flash_dualboot_m33 flash_dualboot"
IMXBOOT_TARGETS_FSPI:imx8ulp-lpddr4-evk = "flash_singleboot_m33_flexspi flash_dualboot_flexspi"
IMXBOOT_TARGETS_ND:imx8ulp-lpddr4-evk   = "flash_singleboot_m33"
```
